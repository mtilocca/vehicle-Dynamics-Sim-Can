## zephyr/modules/st67w61/dts/bindings/wifi/st,st67w61.yaml
```yaml
# Copyright (c) 2024 — project-specific out-of-tree binding
# SPDX-License-Identifier: Apache-2.0

description: |
  ST67W61 Wi-Fi + BT combo module (X-NUCLEO-67W61M1 HAT).
  Communicates with the host STM32 via SPI using ST's framed AT protocol.
  Reference: stm32-hotspot/ST67W61-Bare-metal-implementation
  Pin mapping confirmed from NUCLEO-U575ZI-Q reference project main.h.

compatible: "st,st67w61"

include: spi-device.yaml

properties:
  chip-en-gpios:
    type: phandle-array
    required: true
    description: |
      Chip-enable GPIO. Drive HIGH to enable module, LOW to power it off.
      Use GPIO_ACTIVE_LOW so driver logic treats "assert = module off".
      Confirmed: Arduino D5 = PE11 on NUCLEO-H753ZI (ref: CHIP_EN_Pin GPIOE 11).

  boot-gpios:
    type: phandle-array
    required: true
    description: |
      BOOT mode select. Drive LOW for normal SPI AT-command mode.
      If left floating and module has internal pull-up, HIGH = firmware update mode.
      Confirmed: Arduino D6 = PE9 on NUCLEO-H753ZI (ref: BOOT_Pin GPIOE 9).

  rdy-gpios:
    type: phandle-array
    required: true
    description: |
      SPI_RDY input from module. Module asserts HIGH when ready to send/receive.
      Configure active-high with GPIO_PULL_DOWN (ensures LOW = not-ready when idle).
      Confirmed: Arduino D3 = PE13 on NUCLEO-H753ZI (ref: SPI_RDY_Pin GPIOE 13).
```
